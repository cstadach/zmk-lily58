## config/west.yml
```yaml
manifest:
  remotes:
    - name: zmkfirmware
      url-base: https://github.com/zmkfirmware
    - name: m165437
      url-base: https://github.com/M165437
  projects:
    - name: zmk
      revision: v0.3
      remote: zmkfirmware
      import: app/west.yml
  self:
    path: config
```
